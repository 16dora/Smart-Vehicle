## code/02CameraWebServer/sdkconfig.defaults
```kconfig
CONFIG_IDF_TARGET="esp32"
CONFIG_ESPTOOLPY_FLASHSIZE_4MB=y
CONFIG_PARTITION_TABLE_SINGLE_APP_LARGE=y
CONFIG_SPIRAM=y
CONFIG_SPIRAM_SPEED_40M=y
CONFIG_SPIRAM_USE_MALLOC=y
CONFIG_ESP_MAIN_TASK_STACK_SIZE=6144
# 可选 OLED 使用 UART0 两个信号脚，控制台输出到空设备，避免日志干扰 SPI。
CONFIG_ESP_CONSOLE_NONE=y
CONFIG_BOOTLOADER_LOG_LEVEL_NONE=y
CONFIG_CAMERA_OLED_ENABLED=y
# 网页、视频、运动三个服务独立运行，按 17 项预算并为 DHCP 等预留余量。
CONFIG_LWIP_MAX_SOCKETS=20
# 运动使用常连接二进制帧，握手前校验网页来源和控制连接唯一性。
CONFIG_HTTPD_WS_SUPPORT=y
CONFIG_HTTPD_WS_PRE_HANDSHAKE_CB_SUPPORT=y
# 提高相机数据处理余量，并将相机任务与 CPU0 上的 Wi-Fi 任务分开。
CONFIG_ESP_DEFAULT_CPU_FREQ_MHZ_240=y
# 固定最高 CPU 频率，关闭系统动态电源管理及 STA 未连接时的调制解调器省电。
# CONFIG_PM_ENABLE is not set
# CONFIG_ESP_WIFI_STA_DISCONNECTED_PM_ENABLE is not set
CONFIG_ESP_PHY_MAX_WIFI_TX_POWER=20
CONFIG_CAMERA_CORE1=y
# 常规工程继续使用路由器方案；热点方案通过 sdkconfig.ap.defaults 单独构建。
CONFIG_CAMERA_WIFI_STA=y
# PSRAM 场景使用预分配的 Wi-Fi 发送缓冲，减少逐包申请内部内存的压力。
CONFIG_ESP_WIFI_STATIC_TX_BUFFER=y
CONFIG_ESP_WIFI_STATIC_TX_BUFFER_NUM=16
# TCP 发送缓冲容纳约 16 个默认 MSS 数据段，接收缓冲与超时保持原配置。
CONFIG_LWIP_TCP_SND_BUF_DEFAULT=23040
# 当前 ESP32-CAM 实测参数：低外部时钟、内部倍频及双缓冲，VGA 预览接近 10 FPS。
CONFIG_CAMERA_XCLK_FREQ_HZ=8000000
CONFIG_CAMERA_FRAME_BUFFERS=2
CONFIG_CAMERA_SENSOR_CLK2X=y
CONFIG_CAMERA_DVP_DIV=4
# 常规固件不开放硬件测量接口，也不持续输出任务运行时间。
# CONFIG_CAMERA_PERF_TEST is not set
# 网页运行状态独立启用空闲任务统计，使用固定微秒时钟计算双核忙碌率。
CONFIG_CAMERA_RUNTIME_STATS=y
CONFIG_FREERTOS_GENERATE_RUN_TIME_STATS=y
CONFIG_FREERTOS_RUN_TIME_STATS_USING_ESP_TIMER=y
# 相机和电机均使用新版 I2C 驱动，分别独占 I2C1 与 I2C0。
CONFIG_SCCB_HARDWARE_I2C_DRIVER_NEW=y
CONFIG_SCCB_HARDWARE_I2C_PORT1=y
# 电机模块缺失时仅禁用运动，摄像头服务仍可正常启动。
CONFIG_MOTOR_ENABLED=y
CONFIG_MOTOR_I2C_ADDRESS=0x40
CONFIG_MOTOR_INVERT_MASK=0x0
```

## code/05CameraS3ApSta/sdkconfig.defaults
```kconfig
CONFIG_IDF_TARGET="esp32s3"
CONFIG_ESPTOOLPY_FLASHSIZE_16MB=y
CONFIG_ESPTOOLPY_FLASHMODE_QIO=y
CONFIG_ESPTOOLPY_FLASHFREQ_80M=y
CONFIG_PARTITION_TABLE_SINGLE_APP_LARGE=y
CONFIG_SPIRAM=y
CONFIG_SPIRAM_MODE_OCT=y
CONFIG_SPIRAM_SPEED_80M=y
# 本板 OV3660 实测直接 PSRAM DMA 无法取得完整 JPEG；关闭后内部 DMA 中转取图通过。
# CONFIG_CAMERA_PSRAM_DMA is not set
CONFIG_SPIRAM_USE_MALLOC=y
CONFIG_ESP_MAIN_TASK_STACK_SIZE=6144
# 临时上板诊断：关闭 OLED，GPIO43/44 交还 UART0，COM3 以 115200 输出启动和应用日志。
# 固定母座可能把 GPIO20 接地；仅使用 CH340/UART0 烧录，不使用原生 USB。
# CONFIG_ESP_CONSOLE_NONE is not set
# CONFIG_BOOTLOADER_LOG_LEVEL_NONE is not set
# CONFIG_CAMERA_OLED_ENABLED is not set
# 网页、视频、运动三个服务独立运行，按 17 项预算并为 DHCP 等预留余量。
CONFIG_LWIP_MAX_SOCKETS=20
# 运动使用常连接二进制帧，握手前校验网页来源和控制连接唯一性。
CONFIG_HTTPD_WS_SUPPORT=y
CONFIG_HTTPD_WS_PRE_HANDSHAKE_CB_SUPPORT=y
# 提高相机数据处理余量，并将相机任务与 CPU0 上的 Wi-Fi 任务分开。
CONFIG_ESP_DEFAULT_CPU_FREQ_MHZ_240=y
# 固定最高 CPU 频率，关闭系统动态电源管理及 STA 未连接时的调制解调器省电。
# CONFIG_PM_ENABLE is not set
# CONFIG_ESP_WIFI_STA_DISCONNECTED_PM_ENABLE is not set
CONFIG_ESP_PHY_MAX_WIFI_TX_POWER=20
CONFIG_CAMERA_CORE1=y
# 05 工程固定同时启用热点和路由器连接，配置与 02 独立。
# PSRAM 场景使用预分配的 Wi-Fi 发送缓冲，减少逐包申请内部内存的压力。
CONFIG_ESP_WIFI_STATIC_TX_BUFFER=y
CONFIG_ESP_WIFI_STATIC_TX_BUFFER_NUM=16
# 保留 23 KiB TCP 发送缓冲；64 KiB 扩容实测没有改善吞吐。
CONFIG_LWIP_TCP_SND_BUF_DEFAULT=23040
# OV3660 使用驱动 PLL 与 20 MHz 外部时钟；双缓冲存于 8 MB Octal PSRAM。
CONFIG_CAMERA_XCLK_FREQ_HZ=20000000
CONFIG_CAMERA_FRAME_BUFFERS=2
# 常规固件不开放硬件测量接口，也不持续输出任务运行时间。
# CONFIG_CAMERA_PERF_TEST is not set
# 网页运行状态独立启用空闲任务统计，使用固定微秒时钟计算双核忙碌率。
CONFIG_CAMERA_RUNTIME_STATS=y
CONFIG_FREERTOS_GENERATE_RUN_TIME_STATS=y
CONFIG_FREERTOS_RUN_TIME_STATS_USING_ESP_TIMER=y
# 相机使用新版硬件 I2C1；车轮与机械臂统一使用软件 I2C，共享 GPIO39 时钟。
CONFIG_SCCB_HARDWARE_I2C_DRIVER_NEW=y
CONFIG_SCCB_HARDWARE_I2C_PORT1=y
# 电机模块缺失时仅禁用运动，摄像头服务仍可正常启动。
CONFIG_MOTOR_ENABLED=y
CONFIG_MOTOR_I2C_ADDRESS=0x40
CONFIG_MOTOR_INVERT_MASK=0x0

# 可选机械臂缺失时不阻止相机与车轮；上电不输出舵机脉冲。
CONFIG_ARM_ENABLED=y
CONFIG_CAMERA_WIFI_APSTA=y
CONFIG_CAMERA_AP_SSID="SmartVehicle-CAM"
CONFIG_CAMERA_AP_PASSWORD="123456789"

# 两个机械臂关节的软件标称角度限位，单位为度。
CONFIG_ARM_JOINT0_MIN=5
CONFIG_ARM_JOINT0_MAX=175
CONFIG_ARM_JOINT1_MIN=5
CONFIG_ARM_JOINT1_MAX=175
# 弱信号实测中大帧聚合没有改善吞吐，保留原有 A-MPDU 和内部缓冲。
# CONFIG_SPIRAM_TRY_ALLOCATE_WIFI_LWIP is not set
CONFIG_ESP_WIFI_CACHE_TX_BUFFER_NUM=0
# CONFIG_ESP_WIFI_AMSDU_TX_ENABLED is not set
CONFIG_ESP_WIFI_TX_BA_WIN=6
CONFIG_ESP_WIFI_RX_BA_WIN=6
CONFIG_ESP_WIFI_STATIC_RX_BUFFER_NUM=10
CONFIG_ESP_WIFI_DYNAMIC_RX_BUFFER_NUM=32
CONFIG_LWIP_TCP_WND_DEFAULT=23040
# CONFIG_LWIP_IRAM_OPTIMIZATION is not set
# 使用 1 ms 调度粒度，避免 30 FPS 限速被 10 ms 节拍向上取整。
CONFIG_FREERTOS_HZ=1000
CONFIG_ESP_CONSOLE_UART_DEFAULT=y
# CONFIG_ESP_CONSOLE_SECONDARY_USB_SERIAL_JTAG is not set
CONFIG_ESP_CONSOLE_SECONDARY_NONE=y
CONFIG_ESP_CONSOLE_UART_BAUDRATE=115200
CONFIG_BOOTLOADER_LOG_LEVEL_INFO=y
```

## code/05CameraS3ApSta/source/Kconfig.projbuild
```kconfig
menu "Camera Web Server"

    config CAMERA_OLED_ENABLED
        bool "Enable optional SH1106 128x64 I2C OLED"
        depends on SCCB_HARDWARE_I2C_PORT1
        default y
        help
            I2C0: SDA=GPIO41, SCL=GPIO14, VCC=3.3V, GND=GND.
            Probe 0x3C then 0x3D. The camera uses I2C1 independently.
            Keep microSD disabled. UART0 pins remain available for logging.

    config CAMERA_VERBOSE_LOGS
        bool "Verbose peripheral SDK logs (reduces video throughput on UART)"
        default n
        help
            Keep INFO SDK calls compiled, but normally show warnings/errors for
            high-frequency camera and motion modules. Startup URLs remain INFO.

    config CAMERA_RUNTIME_STATS
        bool
        default y
        select FREERTOS_GENERATE_RUN_TIME_STATS
        help
            Collect idle-task run time for the web status page without enabling
            the temporary /perf endpoints. Use ESP TIMER as the statistics clock.

    config CAMERA_XCLK_FREQ_HZ
        int "Camera external clock frequency (Hz)"
        range 16000000 20000000
        default 16000000
        help
            OV3660 external clock on GPIO15. The component selects its own PLL.
            16 MHz avoids severe network stalls measured on this S3-CAM board.
            Project 03 OV2640 clock doubling and DVP register settings do not apply.

    config CAMERA_PERF_TEST
        bool "Enable temporary performance measurements"
        default n
        select FREERTOS_GENERATE_RUN_TIME_STATS
        help
            Log task CPU time and enable /perf for controlled transfer comparisons.
            This endpoint can stop and restart the camera. Disable after testing.

    config CAMERA_FRAME_BUFFERS
        int "Camera frame buffer count"
        range 1 3
        default 3
        help
            Three buffers keep DMA capture active while one JPEG is held by TCP.



    config CAMERA_WIFI_APSTA
        bool
        default y
        help
            This project always runs a local hotspot and router station together.

    config CAMERA_AP_SSID
        string "Camera hotspot name"
        depends on CAMERA_WIFI_APSTA
        default "SmartVehicle-CAM"
        help
            Hotspot name, 1 to 32 bytes.

    config CAMERA_AP_PASSWORD
        string "Camera hotspot password"
        depends on CAMERA_WIFI_APSTA
        default "123456789"
        help
            WPA2 password, 8 to 63 bytes. This password is compiled into firmware.

endmenu

menu "Vehicle Motor Control"

    config MOTOR_ENABLED
        bool "Enable PCA9685 and two TB6612FNG motor drivers"
        depends on SCCB_HARDWARE_I2C_DRIVER_NEW
        default y
        help
            Software I2C: wheel SDA GPIO47, SCL GPIO39; no hardware controller used.
            Motors remain stopped until a webpage command is received.
            Missing motor hardware does not prevent camera startup.

    config MOTOR_I2C_ADDRESS
        hex "PCA9685 7-bit I2C address"
        range 0x40 0x77
        default 0x40

    config MOTOR_INVERT_MASK
        hex "Reverse wheel wiring (bit0 FL, bit1 FR, bit2 RL, bit3 RR)"
        range 0x0 0xf
        default 0x0
        help
            Set a bit if that wheel runs backwards for a positive wheel command.
            Actual wheel polarity must be checked with the wheels lifted.

endmenu

menu "Optional Robot Arm"
    config ARM_ENABLED
        bool "Enable second PCA9685 and two SG90 servos"
        depends on MOTOR_ENABLED
        default y
        help
            Wheel SDA=47, arm SDA=40, common SCL=39. Both boards use 0x40.
            Keep address pads open. Physical socket positions match project 03.
            Disable microSD and remove the card. Requires 3.3V pullups.
            Outputs stay off until an explicit command; missing arm is optional.
    config ARM_JOINT0_MIN
        int "Joint 0 minimum nominal angle (degrees)"
        range 0 180
        default 5
    config ARM_JOINT0_MAX
        int "Joint 0 maximum nominal angle (degrees)"
        range ARM_JOINT0_MIN 180
        default 175
    config ARM_JOINT1_MIN
        int "Joint 1 minimum nominal angle (degrees)"
        range 0 180
        default 5
    config ARM_JOINT1_MAX
        int "Joint 1 maximum nominal angle (degrees)"
        range ARM_JOINT1_MIN 180
        default 175
endmenu
```
